## boards/seed/wio_tracker_1110/Kconfig.wio_tracker_1110
```kconfig
# Copyright (c) 2016 Nordic Semiconductor ASA
# SPDX-License-Identifier: Apache-2.0

config BOARD_WIO_TRACKER_1110
	select SOC_NRF52840_QIAA
```

## boards/seed/wio_tracker_1110/wio_tracker_1110_defconfig
```kconfig
# SPDX-License-Identifier: Apache-2.0

# Enable MPU
CONFIG_ARM_MPU=y

# Enable hardware stack protection
CONFIG_HW_STACK_PROTECTION=y

# Enable RTT
CONFIG_USE_SEGGER_RTT=n

# enable GPIO
CONFIG_GPIO=y

# enable uart driver
CONFIG_SERIAL=y

# enable console
CONFIG_CONSOLE=y

# Logger cannot use itself to log
CONFIG_USB_CDC_ACM_LOG_LEVEL_OFF=y

# enable USB
CONFIG_USB_DEVICE_STACK=y

# additional board options
# CONFIG_GPIO_AS_PINRESET=y # Deprecated

CONFIG_PINCTRL=y
```

## samples/sid_end_device/boards/wio_tracker_1110_nrf52840.conf
```kconfig
# Sidewalk
CONFIG_SIDEWALK_DFU=n
CONFIG_STATE_NOTIFIER=n
CONFIG_SIDEWALK_RADIO_LR11XX=y

# USB
CONFIG_USB_DEVICE_STACK=y
CONFIG_USB_CDC_ACM_LOG_LEVEL_OFF=y
CONFIG_USB_DEVICE_MANUFACTURER="Seeed Technology"
CONFIG_USB_DEVICE_PRODUCT="Asset Tracker"
CONFIG_USB_DEVICE_VID=0x2886
CONFIG_USB_DEVICE_PID=0x0052

# Build
CONFIG_FLASH_LOAD_OFFSET=0x1000
CONFIG_BUILD_OUTPUT_UF2=y
CONFIG_KERNEL_BIN_NAME="AssetTrackerDeviceApp"
```
